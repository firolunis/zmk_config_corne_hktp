/*
 * Copyright (c) 2020 The ZMK Contributors
 *
 * SPDX-License-Identifier: MIT
 */

#include <behaviors.dtsi>
#include <dt-bindings/zmk/keys.h>
#include <dt-bindings/zmk/bt.h>
#include "zmk-helpers/helper.h"
#include "zmk-helpers/key-labels/36.h"


#define BASE 0
#define NUM 1     
#define NAV 2
#define NP 3
#define RAY 4
#define EXTRA 5
#define MISC 6
#define SCROLL 7
#define BT 8

#include "combos.dtsi"
/*
 * Defines to enable/disable features
 *
 * These defines allow us to conditionally enable and disable parts of the keymap config.
 *
 * For example, if we decide to build the firmware without the mouse features, we can
 * disable all the config options that rely on those forks and modules without having
 * to edit the entire keymap file manually every time.
 */

// #define HAS_MOUSE_KEYS
#define HAS_MOUSE_TP

#ifdef HAS_MOUSE_KEYS
  #include <dt-bindings/zmk/mouse.h>
  #include <behaviors/mouse_keys.dtsi>
#endif  // HAS_MOUSE_KEYS

#ifdef HAS_MOUSE_TP
  // We store the trackpoint settings in a separate file
  // to make organization a little easier.
  #include "include/mouse_tp.dtsi"
  #define U_TOG_TP_SET &tog MOUSE_TP_SET
#else
  #define U_TOG_TP_SET &none
#endif  // HAS_MOUSE_TP



/* Homerow mods */
#define QUICK_TAP_MS 175
#define PRIOR_IDLE 150
#define TAPPING_TERM_NORM 280
#define TAPPING_TERM_FAST 200
#define KEYS_L LT0 LT1 LT2 LT3 LT4 LM0 LM1 LM2 LM3 LM4 LB0 LB1 LB2 LB3 LB4  
#define KEYS_R RT0 RT1 RT2 RT3 RT4 RM0 RM1 RM2 RM3 RM4 RB0 RB1 RB2 RB3 RB4 
#define THUMBS LH2 LH1 LH0 RH0 RH1 RH2                                    

&sk {  // sticky-key config
    release-after-ms = <900>;  // release after 0.9s
    quick-release;             // no double capitalization when rolling keys
};

#define MAKE_HRM(NAME, HOLD, TAP, TRIGGER_POS) \
    ZMK_HOLD_TAP(NAME, \
        flavor = "balanced"; \
        tapping-term-ms = <TAPPING_TERM_NORM>; \
        quick-tap-ms = <QUICK_TAP_MS>; \
        require-prior-idle-ms = <PRIOR_IDLE>; \
        bindings = <HOLD>, <TAP>; \
        hold-trigger-key-positions = <TRIGGER_POS>; \
        hold-trigger-on-release; \
    )
MAKE_HRM(hml, &kp, &kp, KEYS_R THUMBS)  // left-hand HRMs
MAKE_HRM(hmr, &kp, &kp, KEYS_L THUMBS)  // right-hand HRMs


#define MAKE_SHIFT_HRM(NAME, HOLD, TAP, TRIGGER_POS) \
    ZMK_HOLD_TAP(NAME, \
        flavor = "balanced"; \
        tapping-term-ms = <TAPPING_TERM_FAST>; \
        quick-tap-ms = <QUICK_TAP_MS>; \
        require-prior-idle-ms = <PRIOR_IDLE>; \
        bindings = <HOLD>, <TAP>; \
        hold-trigger-key-positions = <TRIGGER_POS>; \
    )
MAKE_SHIFT_HRM(hmls, &kp, &kp, KEYS_R THUMBS)  // left-hand HRMs
MAKE_SHIFT_HRM(hmrs, &kp, &kp, KEYS_L THUMBS)  // right-hand HRMs

// tap: sticky-shift | shift + tap/ double-tap: caps-word | hold: shift
// ZMK_MOD_MORPH(smart_shft,
//    bindings = <&sk LSHFT>, <&caps_word>;
//    mods = <(MOD_LSFT)>;
// )
&caps_word {  // mods deactivate caps-word, requires PR #1451
  /delete-property/ ignore-modifiers;
};

// Disable line-wrap in your editor to see a "visualization" of the key layouts
/ {
    chosen {
      zmk,matrix_transform = &five_column_transform;
    };
    behaviors {
        hm: homerow_mods {
            compatible = "zmk,behavior-hold-tap";
            #binding-cells = <2>;
            tapping-term-ms = <175>;
            quick-tap-ms = <150>;
            require-prior-idle-ms = <185>; 
            flavor = "tap-preferred";
            bindings = <&kp>, <&kp>;
        };
    };
  keymap {
    compatible = "zmk,keymap";

    BASE {
      display-name = "BASE";
      bindings = <
        &hml N2 Q                  &hml N3 W                &hml N4 E               &hml N5 R               &hml N6 T                      &hmr N7 Y                      &hmr N8 U                &hmr N9 I               &hmr N0 O               &hmr MINUS P                   
        &hml LCTRL A               &hml LALT S              &hml LCMD D             &hmls LSHIFT F          &hml LC(LA(LG(LSHIFT))) G      &hmr RC(RA(RG(RSHIFT))) H      &hmrs RSHIFT J           &hmr RCMD K             &hmr RALT L             &hmr RCTRL SEMI         
        &hml LC(LA(LSHIFT)) Z      &lt MISC X               &lt EXTRA C             &lt RAY V               &lt NP B                       &lt NP N                       &lt RAY M                &lt EXTRA COMMA         &lt MISC DOT            &hmr RC(RA(RSHIFT)) SLASH 
                                                            &lt NAV BACKSPACE       &lt NUM SPACE           &mkp LCLK                      &mo SCROLL                     &lt NUM ENTER            &lt NAV ESC
      >;  
    };
    
    NUM {
      display-name = "NUM";
      bindings = <
        &hml LS(N2) N2              &hml LS(N3) N3          &hml LS(N4) N4          &hml LS(N5) N5          &hml LS(N6) N6                 &hmr LS(N7) N7                  &hmr LS(N8) N8          &hmr LS(N9) N9          &hmr LS(N0) N0          &hmr LS(MINUS) MINUS
        &hml LCTRL N1               &hml LALT F1            &hml LCMD F2            &hml LEFT_SHIFT F3      &hml LC(LA(LG(LSHIFT))) F4     &hmr RC(RA(RG(RSHIFT))) F5      &hmr RSHIFT F6          &hmr RCMD PRINTSCREEN   &hmr RALT EQUAL         &hmr RCTRL LEFT_BRACKET
        &hml LC(LA(LSHIFT)) GRAVE   &kp F7                  &kp F8                  &kp F9                  &kp F10                        &kp F11                         &kp F12                 &kp BACKSLASH           &kp RIGHT_BRACKET       &hmr RC(RA(RSHIFT)) SINGLE_QUOTE
                                                            &kp DEL                 &kp TAB                 &mkp RCLK                      &mkp RCLK                       &kp TAB                 &kp ESC
      >;
    };

    NAV {
      display-name = "NAV";
      bindings = <
        &kp C_BRI_UP                &kp PG_UP               &kp UP                  &kp PG_DN               &kp LC(LS(TAB))                &none                           &kp C_PREV              &kp C_PLAY_PAUSE        &kp C_NEXT              &kp RC(LEFT)
        &kp HOME                    &kp LEFT                &kp DOWN                &kp RIGHT               &kp END                        &kp LEFT                        &kp DOWN                &kp UP                  &kp RIGHT               &kp RC(UP)
        &kp C_BRI_DN                &kp K_MUTE              &kp C_VOL_DN            &kp C_VOL_UP            &kp LC(TAB)                    &kp HOME                        &kp PG_DN               &kp PG_UP               &kp END                 &kp RC(RIGHT)
                                                            &kp DEL                 &kp TAB                 &mkp MCLK                      &mkp MCLK                       &kp TAB                 &kp ESC
      >;
    };

    NP {
      display-name = "NP";
      bindings = <
        &kp KP_SUBTRACT             &kp KP_N9               &kp KP_N8               &kp KP_N7               &kp KP_ASTERISK                &kp KP_ASTERISK                 &kp KP_N7               &kp KP_N8               &kp KP_N9               &kp KP_SUBTRACT
        &kp KP_PLUS                 &kp KP_N6               &kp KP_N5               &kp KP_N4               &kp KP_SLASH                   &kp KP_SLASH                    &kp KP_N4               &kp KP_N5               &kp KP_N6               &kp KP_PLUS
        &kp KP_ENTER                &kp KP_N3               &kp KP_N2               &kp KP_N1               &none                          &none                           &kp KP_N1               &kp KP_N2               &kp KP_N3               &kp KP_ENTER
                                                            &kp KP_DOT              &kp KP_N0               &mkp LCLK                      &mkp LCLK                           &kp KP_N0               &kp KP_DOT
      >;
    };

    RAY {
      display-name = "RAY";
      bindings = <
        &kp F13             &kp F14       &kp F15   &kp F16     &kp F17                        &kp F18                      &kp F19     &kp F20   &kp F21        &kp F22
        &kp LCTRL           &kp LALT      &kp LCMD  &kp LSHIFT  &hml LC(LA(LG(LSHIFT))) F23    &hmr RC(RA(RG(RSHIFT))) F24  &kp RSHIFT  &kp RCMD  &kp RALT       &kp RCTRL
        &kp LC(LA(LSHIFT))  &none         &none     &none       &none                          &none                        &none       &none     &none          &kp RC(RA(RSHIFT))
                                          &none     &none       &none                          &none                        &none       &none
      >;
    };

    // You can find the defines for the actual key press behaviors in `include/mouse_tp.dtsi`.
    EXTRA {
      display-name = "EXTRA";
      bindings = <
        &none                    &none                    U_MSS_TP_S_D             U_MSS_TP_S_I             U_MSS_TP_PT_I                 U_MSS_TP_PT_I            U_MSS_TP_S_D             U_MSS_TP_S_I             &none                    &none    
        U_MSS_RESET              &none                    U_MSS_TP_NI_D            U_MSS_TP_NI_I            U_MSS_TP_PT_D                 U_MSS_TP_PT_D            U_MSS_TP_NI_D            U_MSS_TP_NI_I            &none                    U_MSS_RESET          
        U_MSS_LOG                &none                    U_MSS_TP_V6_D            U_MSS_TP_V6_I            &none                         &none                    U_MSS_TP_V6_D            U_MSS_TP_V6_I            &none                    U_MSS_LOG
                                                          &trans                   &none                    &none                         &mkp LCLK                &mkp MCLK                &mkp RCLK
      >;
    };

    MISC {
      display-name = "MISC";
      bindings = <
        &none                    &none                    &none                    &none                    &none                         &none                    &none                    &none                    &none                    &none    
        &none                    &none                    &none                    &none                    &none                         &none                    &none                    &none                    &none                    &none                  
        &none                    &none                    &mo BT                   &none                    &none                         &none                    &none                    &mo BT                   &none                    &none                    
                                                          &mkp RCLK                &mkp MCLK                &mkp LCLK                     &mkp LCLK                &mkp MCLK                &mkp RCLK
      >;
    };

    SCROLL {
      display-name = "SCROLL";
      bindings = <
        &none                    &trans                   &trans                   &trans                   &trans                        &kp LC(LS(TAB))          &msc SCRL_UP             &kp UP                   &mkp RCLK                &kp RC(LEFT)         
        &kp LCTRL                &kp LALT                 &kp LCMD                 &kp LSHIFT               &trans                        &mkp LCLK                &kp LEFT                 &kp DOWN                 &kp RIGHT                &kp RC(UP)         
        &none                    &trans                   &trans                   &trans                   &trans                        &kp LC(TAB)              &msc SCRL_DOWN           &msc SCRL_RIGHT          &msc SCRL_LEFT           &kp RC(RIGHT)         
                                                          &trans                   &trans                   &trans                        &trans                   &trans                   &trans 
      >;
    };

    BT {
      display-name = "BT";
      bindings = <
       &bt BT_SEL 0   &bt BT_SEL 1   &bt BT_SEL 2   &bt BT_SEL 3   &bt BT_SEL 4     &bt BT_SEL 4   &bt BT_SEL 3   &bt BT_SEL 2   &bt BT_SEL 1   &bt BT_SEL 0
       &bt BT_DISC 0  &bt BT_DISC 1  &bt BT_DISC 2  &bt BT_DISC 3  &bt BT_DISC 4    &bt BT_DISC 4  &bt BT_DISC 3  &bt BT_DISC 2  &bt BT_DISC 1  &bt BT_DISC 0
       &none          &none          &bt BT_CLR     &none          &bootloader            &bootloader          &none          &bt BT_CLR     &none          &none
                                     &none          &none          &none            &none          &none          &none
      >;
    };
    
  };

};
